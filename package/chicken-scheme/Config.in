## package/chicken-scheme/Config.in
```kconfig
config BR2_PACKAGE_CHICKEN_SCHEME
       depends on BR2_aarch64
       bool "Chicken Scheme"
	help
	  The Chicken Scheme implementation.
```

## package/chicken-scheme/Config.in.host
```kconfig
config BR2_PACKAGE_HOST_CHICKEN_SCHEME
       select BR2_PACKAGE_CHICKEN_SCHEME
       bool "Host Chicken Scheme"
	help
	  The Chicken Scheme implementation.
```
